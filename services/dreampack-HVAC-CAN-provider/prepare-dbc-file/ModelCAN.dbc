VERSION "HINBNNNYNNNNNNNNNNNNNNNNNNNNNNNNNNNYYNNNNN/4>%%%/4/'%**4NNN///"

NS_ :

BS_:

BU_: Parking

BO_ 821 Distance_06: 8 Parking
 SG_ Dst_S12_06 : 47|11@0+ (0.01,0) [0|20.02] "m" Vector__XXX
 SG_ Dst_S11_06 : 18|11@0+ (0.01,0) [0|20.02] "m" Vector__XXX

BO_ 820 Distance_05: 8 Parking
 SG_ Dst_S10_05 : 47|11@0+ (0.01,0) [0|20.02] "m" Vector__XXX
 SG_ Dst_S09_05 : 18|11@0+ (0.01,0) [0|20.02] "m" Vector__XXX

BO_ 819 Distance_04: 8 Parking
 SG_ Dst_S08_04 : 47|11@0+ (0.01,0) [0|20.02] "m" Vector__XXX
 SG_ Dst_S07_04 : 18|11@0+ (0.01,0) [0|20.02] "m" Vector__XXX

BO_ 818 Distance_03: 8 Parking
 SG_ Dst_S06_03 : 47|11@0+ (0.01,0) [0|20.02] "m" Vector__XXX
 SG_ Dst_S05_03 : 18|11@0+ (0.01,0) [0|20.02] "m" Vector__XXX

BO_ 817 Distance_02: 8 Parking
 SG_ Dst_S04_02 : 47|11@0+ (0.01,0) [0|20.02] "m" Vector__XXX
 SG_ Dst_S03_02 : 18|11@0+ (0.01,0) [0|20.02] "m" Vector__XXX

BO_ 816 Distance_01: 8 Parking
 SG_ Dst_S02_01 : 47|11@0+ (0.01,0) [0|20.02] "m" Vector__XXX
 SG_ Dst_S01_01 : 18|11@0+ (0.01,0) [0|20.02] "m" Vector__XXX

BA_DEF_  "BusType" STRING ;
BA_DEF_ BU_  "DiagNode" ENUM  "No","Yes";
BA_DEF_ BU_  "EOL_SB_Flash" ENUM  "No","Yes";
BA_DEF_ BO_  "GenMsgCycleTime" INT 0 10000;
BA_DEF_ BO_  "GenMsgDelayTime" INT 0 1000;
BA_DEF_ BO_  "GenMsgILSupport" ENUM  "No","Yes";
BA_DEF_ BO_  "GenMsgSendType" ENUM  "FixedPeriodic","Event","EnabledPeriodic","NotUsed","NotUsed","EventPeriodic","NotUsed","NotUsed","NoMsgSendType";
BA_DEF_ SG_  "GenSigSendType" ENUM  "Cyclic","OnWrite","OnWriteWithRepetition","OnChange","OnChangeWithRepetition","IfActive","IfActiveWithRepetition","NoSigSendType";
BA_DEF_ SG_  "GenSigStartValue" FLOAT 0 100000000000;
BA_DEF_  "Manufacturer" STRING ;
BA_DEF_ BU_  "NetworkType" ENUM  "Powertrain","Bodybus","Infotainment";
BA_DEF_  "NmBaseAddress" HEX 0 1280;
BA_DEF_ BU_  "NmCAN" INT 1 2;
BA_DEF_  "NmMessageCount" INT 0 128;
BA_DEF_  "NmType" STRING ;
BA_DEF_ BU_  "NodeLayerModules" STRING ;
BA_DEF_ BU_  "PowerType" ENUM  "Ignition Switched","Secondary Switched","Sleep";
BA_DEF_ BU_  "TransceiverType" ENUM  "Unknown","TJA1050","TJA1040","TJA1041","82C250","TLE6250","MC33989","CS251";
BA_DEF_ BU_  "Version_Ccl" STRING ;
BA_DEF_ BU_  "Version_Diag_CANdesc" STRING ;
BA_DEF_ BU_  "Version_DrvCan" STRING ;
BA_DEF_ BU_  "Version_GW_ILGateway" STRING ;
BA_DEF_ BU_  "Version_IL_NI_Ford" STRING ;
BA_DEF_ BU_  "Version_IL_Vector" STRING ;
BA_DEF_ BU_  "Version_NM_DirOsek" STRING ;
BA_DEF_ BU_  "Version_NM_Junior" STRING ;
BA_DEF_ BU_  "Version_Tp_Iso15765" STRING ;
BA_DEF_  "VersionDay" INT 0 31;
BA_DEF_  "VersionMonth" INT 0 12;
BA_DEF_  "VersionNumber" INT 0 100;
BA_DEF_  "VersionYear" INT 2000 2100;
BA_DEF_ SG_  "GenSigEnvVarType" ENUM  "int","float","undef";
BA_DEF_  "NmAsrTimeoutTime" INT 1 65535;
BA_DEF_  "NmAsrWaitBusSleepTime" INT 0 65535;
BA_DEF_  "NmAsrRepeatMessageTime" INT 0 65535;
BA_DEF_  "NmAsrMessageCount" INT 1 256;
BA_DEF_  "NmAsrBaseAddress" HEX 0 2047;
BA_DEF_  "NmAsrCanMsgCycleTime" INT 1 65535;
BA_DEF_ BU_  "NmAsrCanMsgReducedTime" INT 1 65535;
BA_DEF_ BO_  "GenMsgTxConditionIg1On" ENUM  "No","Yes";
BA_DEF_ SG_  "GenSigSuprvResp_VCM" ENUM  "None","Notify","Substitute","NotifySubstitute";
BA_DEF_ SG_  "GenSigSuprvRespSubValue_VCM" INT 0 10000000000;
BA_DEF_ SG_  "GenSigInvalidValue" INT 0 10000000000;
BA_DEF_ BU_  "CANoeNodTxTimingIgnitionSwitched" ENUM  "AccOn","IG1On","IG2On","NoNodTxTiming";
BA_DEF_ BO_  "CANoeMsgTxTimingIgnitionSwitched" ENUM  "AccOn","IG1On","IG2On","NoMsgTxTiming";
BA_DEF_  "NM_Active" ENUM  "Active","NotActive";
BA_DEF_DEF_  "BusType" "CAN";
BA_DEF_DEF_  "DiagNode" "Yes";
BA_DEF_DEF_  "EOL_SB_Flash" "Yes";
BA_DEF_DEF_  "GenMsgCycleTime" 0;
BA_DEF_DEF_  "GenMsgDelayTime" 20;
BA_DEF_DEF_  "GenMsgILSupport" "Yes";
BA_DEF_DEF_  "GenMsgSendType" "NoMsgSendType";
BA_DEF_DEF_  "GenSigSendType" "NoSigSendType";
BA_DEF_DEF_  "GenSigStartValue" 0;
BA_DEF_DEF_  "Manufacturer" "Ford";
BA_DEF_DEF_  "NetworkType" "Powertrain";
BA_DEF_DEF_  "NmBaseAddress" 1280;
BA_DEF_DEF_  "NmCAN" 1;
BA_DEF_DEF_  "NmMessageCount" 128;
BA_DEF_DEF_  "NmType" "Ford-OSEK";
BA_DEF_DEF_  "NodeLayerModules" "";
BA_DEF_DEF_  "PowerType" "Ignition Switched";
BA_DEF_DEF_  "TransceiverType" "Unknown";
BA_DEF_DEF_  "Version_Ccl" "00.00.00";
BA_DEF_DEF_  "Version_Diag_CANdesc" "00.00.00";
BA_DEF_DEF_  "Version_DrvCan" "00.00.00";
BA_DEF_DEF_  "Version_GW_ILGateway" "00.00.00";
BA_DEF_DEF_  "Version_IL_NI_Ford" "00.00.00";
BA_DEF_DEF_  "Version_IL_Vector" "00.00.00";
BA_DEF_DEF_  "Version_NM_DirOsek" "00.00.00";
BA_DEF_DEF_  "Version_NM_Junior" "00.00.00";
BA_DEF_DEF_  "Version_Tp_Iso15765" "00.00.00";
BA_DEF_DEF_  "VersionDay" 1;
BA_DEF_DEF_  "VersionMonth" 1;
BA_DEF_DEF_  "VersionNumber" 1;
BA_DEF_DEF_  "VersionYear" 2005;
BA_DEF_DEF_  "GenSigEnvVarType" "undef";
BA_DEF_DEF_  "NmAsrTimeoutTime" 1000;
BA_DEF_DEF_  "NmAsrWaitBusSleepTime" 750;
BA_DEF_DEF_  "NmAsrRepeatMessageTime" 400;
BA_DEF_DEF_  "NmAsrMessageCount" 128;
BA_DEF_DEF_  "NmAsrBaseAddress" 1408;
BA_DEF_DEF_  "NmAsrCanMsgCycleTime" 100;
BA_DEF_DEF_  "NmAsrCanMsgReducedTime" 50;
BA_DEF_DEF_  "GenMsgTxConditionIg1On" "No";
BA_DEF_DEF_  "GenSigSuprvResp_VCM" "None";
BA_DEF_DEF_  "GenSigSuprvRespSubValue_VCM" 0;
BA_DEF_DEF_  "GenSigInvalidValue" 0;
BA_DEF_DEF_  "CANoeNodTxTimingIgnitionSwitched" "NoNodTxTiming";
BA_DEF_DEF_  "CANoeMsgTxTimingIgnitionSwitched" "NoMsgTxTiming";
BA_DEF_DEF_  "NM_Active" "NotActive";
BA_ "VersionNumber" 16;
BA_ "VersionDay" 20;
BA_ "VersionMonth" 12;
BA_ "VersionYear" 2022;
BA_ "NmType" "NmAsr";
BA_ "NmAsrTimeoutTime" 3000;
BA_ "NmAsrWaitBusSleepTime" 1500;
BA_ "NmAsrRepeatMessageTime" 5000;
BA_ "NmAsrCanMsgCycleTime" 1000;
BA_ "NodeLayerModules" BU_ Parking "CANoeILNLVector.dll";
BA_ "CANoeNodTxTimingIgnitionSwitched" BU_ Parking 1;
BA_ "GenMsgSendType" BO_ 821 0;
BA_ "GenMsgCycleTime" BO_ 821 50;
BA_ "GenMsgTxConditionIg1On" BO_ 821 1;
BA_ "GenMsgSendType" BO_ 820 0;
BA_ "GenMsgCycleTime" BO_ 820 50;
BA_ "GenMsgTxConditionIg1On" BO_ 820 1;
BA_ "GenMsgSendType" BO_ 819 0;
BA_ "GenMsgCycleTime" BO_ 819 50;
BA_ "GenMsgTxConditionIg1On" BO_ 819 1;
BA_ "GenMsgSendType" BO_ 818 0;
BA_ "GenMsgCycleTime" BO_ 818 50;
BA_ "GenMsgTxConditionIg1On" BO_ 818 1;
BA_ "GenMsgSendType" BO_ 817 0;
BA_ "GenMsgCycleTime" BO_ 817 50;
BA_ "GenMsgTxConditionIg1On" BO_ 817 1;
BA_ "GenMsgSendType" BO_ 816 0;
BA_ "GenMsgCycleTime" BO_ 816 50;
BA_ "GenMsgTxConditionIg1On" BO_ 816 1;
BA_ "GenSigStartValue" SG_ 821 Dst_S12_06 2001;
BA_ "GenSigSuprvResp_VCM" SG_ 821 Dst_S12_06 2;
BA_ "GenSigSuprvRespSubValue_VCM" SG_ 821 Dst_S12_06 2002;
BA_ "GenSigInvalidValue" SG_ 821 Dst_S12_06 2002;
BA_ "GenSigStartValue" SG_ 821 Dst_S11_06 2001;
BA_ "GenSigSuprvResp_VCM" SG_ 821 Dst_S11_06 2;
BA_ "GenSigSuprvRespSubValue_VCM" SG_ 821 Dst_S11_06 2002;
BA_ "GenSigInvalidValue" SG_ 821 Dst_S11_06 2002;
BA_ "GenSigStartValue" SG_ 820 Dst_S10_05 2001;
BA_ "GenSigSuprvResp_VCM" SG_ 820 Dst_S10_05 2;
BA_ "GenSigSuprvRespSubValue_VCM" SG_ 820 Dst_S10_05 2002;
BA_ "GenSigInvalidValue" SG_ 820 Dst_S10_05 2002;
BA_ "GenSigStartValue" SG_ 820 Dst_S09_05 2001;
BA_ "GenSigSuprvResp_VCM" SG_ 820 Dst_S09_05 2;
BA_ "GenSigSuprvRespSubValue_VCM" SG_ 820 Dst_S09_05 2002;
BA_ "GenSigInvalidValue" SG_ 820 Dst_S09_05 2002;
BA_ "GenSigStartValue" SG_ 819 Dst_S08_04 2001;
BA_ "GenSigSuprvResp_VCM" SG_ 819 Dst_S08_04 2;
BA_ "GenSigSuprvRespSubValue_VCM" SG_ 819 Dst_S08_04 2002;
BA_ "GenSigInvalidValue" SG_ 819 Dst_S08_04 2002;
BA_ "GenSigStartValue" SG_ 819 Dst_S07_04 2001;
BA_ "GenSigSuprvResp_VCM" SG_ 819 Dst_S07_04 2;
BA_ "GenSigSuprvRespSubValue_VCM" SG_ 819 Dst_S07_04 2002;
BA_ "GenSigInvalidValue" SG_ 819 Dst_S07_04 2002;
BA_ "GenSigStartValue" SG_ 818 Dst_S06_03 2001;
BA_ "GenSigSuprvResp_VCM" SG_ 818 Dst_S06_03 2;
BA_ "GenSigSuprvRespSubValue_VCM" SG_ 818 Dst_S06_03 2002;
BA_ "GenSigInvalidValue" SG_ 818 Dst_S06_03 2002;
BA_ "GenSigStartValue" SG_ 818 Dst_S05_03 2001;
BA_ "GenSigSuprvResp_VCM" SG_ 818 Dst_S05_03 2;
BA_ "GenSigSuprvRespSubValue_VCM" SG_ 818 Dst_S05_03 2002;
BA_ "GenSigInvalidValue" SG_ 818 Dst_S05_03 2002;
BA_ "GenSigStartValue" SG_ 817 Dst_S04_02 2001;
BA_ "GenSigSuprvResp_VCM" SG_ 817 Dst_S04_02 2;
BA_ "GenSigSuprvRespSubValue_VCM" SG_ 817 Dst_S04_02 2002;
BA_ "GenSigInvalidValue" SG_ 817 Dst_S04_02 2002;
BA_ "GenSigStartValue" SG_ 817 Dst_S03_02 2001;
BA_ "GenSigSuprvResp_VCM" SG_ 817 Dst_S03_02 2;
BA_ "GenSigSuprvRespSubValue_VCM" SG_ 817 Dst_S03_02 2002;
BA_ "GenSigInvalidValue" SG_ 817 Dst_S03_02 2002;
BA_ "GenSigStartValue" SG_ 816 Dst_S02_01 2001;
BA_ "GenSigSuprvResp_VCM" SG_ 816 Dst_S02_01 2;
BA_ "GenSigSuprvRespSubValue_VCM" SG_ 816 Dst_S02_01 2002;
BA_ "GenSigInvalidValue" SG_ 816 Dst_S02_01 2002;
BA_ "GenSigStartValue" SG_ 816 Dst_S01_01 2001;
BA_ "GenSigSuprvResp_VCM" SG_ 816 Dst_S01_01 2;
BA_ "GenSigSuprvRespSubValue_VCM" SG_ 816 Dst_S01_01 2002;
BA_ "GenSigInvalidValue" SG_ 816 Dst_S01_01 2002;
